## config/Kconfig
```kconfig
config ZMK_IMPRINT_BATTERY_RGB
	bool
	default y if SHIELD_IMPRINT_LEFT || SHIELD_IMPRINT_RIGHT
	depends on ZMK_BATTERY_REPORTING && ZMK_RGB_UNDERGLOW

config ZMK_IMPRINT_BATTERY_HID
	bool
	default y if SHIELD_IMPRINT_DONGLE
	depends on ZMK_USB && ZMK_SPLIT_BLE_CENTRAL_BATTERY_LEVEL_FETCHING
```
