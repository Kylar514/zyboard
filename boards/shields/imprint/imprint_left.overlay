// Left half devicetree overlay.
// Includes the shared shield definition and assigns the row GPIOs for the
// left half of the keyboard matrix.
// Trackball (PMW3610) nodes are intentionally omitted.

#include "imprint.dtsi"

&kscan0 {
    row-gpios
        = <&gpio1 4  GPIO_ACTIVE_HIGH>  // row0
        , <&gpio0 11 GPIO_ACTIVE_HIGH>  // row1
        , <&gpio0 29 GPIO_ACTIVE_HIGH>  // row2
        , <&gpio1 0  GPIO_ACTIVE_HIGH>  // row3
        , <&gpio0 10 GPIO_ACTIVE_HIGH>  // row4
        , <&gpio0 2  GPIO_ACTIVE_HIGH>  // row5
        , <&gpio0 9  GPIO_ACTIVE_HIGH>  // row6
        ;
};
